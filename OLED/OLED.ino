#include "U8glib.h"
 int x=57,y=11;
 int xvalue,yvalue,swvalue;
 U8GLIB_SSD1306_128X64 u8g(U8G_I2C_OPT_NONE|U8G_I2C_OPT_DEV_0);
#define u8g_logo_width 128
#define u8g_logo_height 64

static unsigned char menue[] U8G_PROGMEM = {
0x00,0x00,0x00,0x00,0x00,0x00,0x00,0x00,0x00,0x00,0x00,0x00,0x00,0x00,0x00,0x00,
0x00,0x00,0x00,0x00,0x00,0x00,0x00,0x00,0x00,0x00,0x00,0x00,0x00,0x00,0x00,0x00,
0x00,0x00,0x00,0x00,0x00,0x00,0x00,0x00,0x00,0x00,0x00,0x00,0x00,0x00,0x00,0x00,
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0x00,0x00,0x00,0x00,0x00,0x00,0x00,0x00,0x00,0x00,0x00,0x00,0x00,0x00,0x00,0x00,
 };

static unsigned char arrow[] U8G_PROGMEM ={
  0x00,0x00,0x18,0x0C,0x7E,0x00,0x00,0x00
  };

  void draw(int alter) {
  if(alter==0)
  {
  u8g.drawXBMP( 0, 0, u8g_logo_width, u8g_logo_height, menue);
  u8g.drawXBMP(x,y,8,8,arrow);
  }
  else if(alter==1)
{
  u8g.setFont(u8g_font_fixed_v0r);
  u8g.drawStr(0,20,"temperature:");
    u8g.drawStr(0,40,"humidity:");
  u8g.setPrintPos(90,30);
  u8g.print(27);
  u8g.setPrintPos(90,50);
  u8g.print(50);
}
      else if(alter==2)
{u8g.setFont(u8g_font_7x13);
  u8g.drawStr(0,20,"weight:");
  u8g.setPrintPos(0,50);
  u8g.print(10.0);
}
      else if(alter==3)
{u8g.setFont(u8g_font_fixed_v0r);
  u8g.drawStr(0,20,"You shall drink");
  u8g.setPrintPos(0,40);
  u8g.print(8);
  u8g.setFont(u8g_font_fixed_v0r);
  u8g.drawStr(0,60,"cups of water this day.");}

}
void ReadStick(int &xvalu,int &yvalu,int &swvalu)
{
xvalu=analogRead(A1);
yvalu=analogRead(A2);
swvalu=analogRead(A0);
  }
  void limitAndJudge()
{
  ReadStick(xvalue,yvalue,swvalue);
  if(yvalue>700)
  {y+=20;x+=29;}
  else if(yvalue<50)
  {y-=20;x-=29;}
  if (y<0)
  y=51;
  if(y>64)
  y=11;
  if(x<50)
  x=115;
  if(x>120)
  x=57;
  }
void setup() {
  
}

void loop() {
  // put your main code here, to run repeatedly:
limitAndJudge();
  if(swvalue>100)
  {
  u8g.firstPage();  
  do {
    draw(0);
  } while( u8g.nextPage() );
  }
  else
     {u8g.firstPage();  
  do {
    if(x==57)draw(1);
    else if(x==86)draw(2);
    else if(x==115)draw(3);
    else draw(0);
  } while( u8g.nextPage() );}
}
